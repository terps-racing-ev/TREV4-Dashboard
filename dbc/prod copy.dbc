VERSION ""

NS_ :

BS_:

BU_:

BO_ 2147540693 battery: 16 Vector__XXX
    SG_ PackVoltage : 0|16@1- (0.1,0) [0|420] "V" Vector__XXX
    SG_ PackCurrent : 16|16@1- (0.1,0) [0|100] "A" Vector__XXX
    SG_ StateOfCharge : 32|16@1- (0.1,0) [0|100] "%" Vector__XXX
    SG_ CellVoltageMin : 48|8@1- (0.01,0) [3|4.2] "V" Vector__XXX
	SG_ CellTemp : 64|8@1- (1,0) [0|200] "°C" Vector__XXX
	SG_ CellVoltage : 80|8@1- (0.1,0) [0|400] "V" Vector__XXX

VERSION ""

NS_ :

BS_:

BU_:

BO_ 2147540694 gforce: 8 Vector__XXX
	SG_ LateralG : 0|16@1- (0.1,0) [-2|2] "G" Vector__XXX
	SG_ LongitudinalG : 16|16@1- (0.1,0) [-2|2] "G" Vector__XXX
